## sdkconfig.defaults.rl-bt-dsp
```kconfig
# RL BT DSP Speaker - ESP32-WROVER-IE + PCM5102 + TPA3118
CONFIG_BOARD_ESP32_GENERIC=y
CONFIG_ESPTOOLPY_FLASHSIZE_4MB=y
CONFIG_ESPTOOLPY_FLASHSIZE="4MB"
CONFIG_PARTITION_TABLE_CUSTOM_FILENAME="components/boards/partitions-4m.csv"
CONFIG_ESP32_SPIRAM_SUPPORT=y
CONFIG_SPIRAM_USE_MALLOC=y
CONFIG_I2S_BCK_IO=26
CONFIG_I2S_WS_IO=25
CONFIG_I2S_DO_IO=22
CONFIG_DAC_I2C_SDA=-1
CONFIG_DAC_I2C_SCL=-1
CONFIG_SPDIF_DO_IO=-1
CONFIG_DAC_PCM5102=y
CONFIG_BT_ENABLED=y
CONFIG_BT_CLASSIC_ENABLED=y
CONFIG_BT_A2DP_ENABLE=y
CONFIG_BTDM_CTRL_MODE_BTDM=y
CONFIG_AIRPLAY_NAME="RL BT DSP"
CONFIG_AIRPLAY_FORCE_V1=y
CONFIG_BTN_PLAY_PAUSE_GPIO=33
CONFIG_BTN_VOLUME_UP_GPIO=27
CONFIG_BTN_VOLUME_DOWN_GPIO=14
CONFIG_DISPLAY_ENABLED=n
CONFIG_LED_STATUS_BRIGHTNESS=0
CONFIG_ESP_WIFI_STATIC_RX_BUFFER_NUM=16
CONFIG_ESP_WIFI_DYNAMIC_RX_BUFFER_NUM=64
CONFIG_ESP_WIFI_DYNAMIC_TX_BUFFER_NUM=32
CONFIG_SPIRAM_USE_CAPS_ALLOC=y
CONFIG_ESP_MAIN_TASK_STACK_SIZE=8192
CONFIG_BTDM_CTRL_MODE_BR_EDR_ONLY=y
CONFIG_BT_SSP_ENABLED=y
CONFIG_FREERTOS_PLACE_FUNCTIONS_INTO_FLASH=y
```
